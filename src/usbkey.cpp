// JieLi USB_KEY and calibration pulses on the ESP32-S3's native USB pins.
//
// The app detaches the internal USB PHY and drives D+/D- as plain GPIOs:
//   1. Key 0x16EF, MSB first, D+ = clock, D- = data (push-pull, as Transporter
//      and the Flipper app), repeated until the ROM answers.
//   2. ROM answer: D- held low (ACK), then D+ pulled up by the ROM.
//   3. Calibration: a 4 us low pulse on D+ every 1 ms, open-drain, generated by
//      the RMT peripheral so OS scheduling cannot disturb it. The ROM trims its
//      USB clock from these; jittery pulses gave "Device Descriptor Request
//      Failed" on the PC in the Flipper app's tests.
//   4. Stop when D+ drops after >= 1 s (calibration done) or after 6 s.
//
// Timings follow FM-1-transporter src/recovery.c and pio/usb_key.pio, and
// merthsoft/flipper-fm1-recovery v0.7, both verified on a real FM-1.
#include "usbkey.h"

#include <Arduino.h>
#include <driver/gpio.h>
#include <driver/rmt_tx.h>
#include <esp_cpu.h>
#include <esp_rom_sys.h>
#include <esp_timer.h>
#include <hal/usb_serial_jtag_ll.h>
#include <soc/gpio_reg.h>

namespace usbkey {

static constexpr gpio_num_t PIN_DP = GPIO_NUM_20;
static constexpr gpio_num_t PIN_DM = GPIO_NUM_19;
static constexpr uint32_t DP_MASK = 1u << PIN_DP;
static constexpr uint32_t DM_MASK = 1u << PIN_DM;

static constexpr uint16_t USB_KEY = 0x16EF;
static constexpr uint32_t KEY_SLOT_US = 340;  // key packet + settle, as Transporter
static constexpr int GAP_PROBES = 4;
static constexpr uint32_t GAP_PROBE_SPACING_US = 35;
static constexpr int ACK_PROBE_LOWS = 2;
static constexpr uint32_t DP_HIGH_TIMEOUT_MS = 500;

static constexpr uint32_t PULSE_RES_HZ = 10000000;  // 10 MHz = 0.1 us ticks, APB/8
static constexpr uint16_t PULSE_LOW_TICKS = 40;     // 4 us low
static constexpr uint16_t PULSE_HIGH_TICKS = 9960;  // rest of the 1 ms period
static constexpr uint32_t PULSE_MAX_MS = 6000;      // as every proven run
static constexpr uint32_t CAL_DONE_MIN_MS = 1000;   // D+ drop after this = calibration done
static constexpr uint32_t PULSE_SAMPLE_US = 100;
static constexpr int PULSE_LOW_SAMPLES = 3;         // 300 us low, not one of our 4 us pulses

static portMUX_TYPE key_mux = portMUX_INITIALIZER_UNLOCKED;
static uint32_t cycles_per_us;

static inline uint32_t cycles() { return esp_cpu_get_cycle_count(); }
static inline void wait_until(uint32_t deadline) {
    while ((int32_t)(cycles() - deadline) < 0) {
    }
}
bool dp() { return REG_READ(GPIO_IN_REG) & DP_MASK; }
static inline bool dm() { return REG_READ(GPIO_IN_REG) & DM_MASK; }

// Detach the USB Serial/JTAG PHY (and its 1.5 kOhm D+ pull-up) from the pins.
static void usb_phy_detach() {
    usb_serial_jtag_pull_override_vals_t off = {};
    usb_serial_jtag_ll_phy_enable_pull_override(&off);
    usb_serial_jtag_ll_phy_enable_pad(false);
}

void bus_init() {
    gpio_config_t io = {};
    io.pin_bit_mask = DP_MASK | DM_MASK;
    io.mode = GPIO_MODE_INPUT_OUTPUT;
    io.pull_down_en = GPIO_PULLDOWN_ENABLE;
    io.pull_up_en = GPIO_PULLUP_DISABLE;
    io.intr_type = GPIO_INTR_DISABLE;
    gpio_config(&io);
    usb_phy_detach();
    gpio_set_drive_capability(PIN_DP, GPIO_DRIVE_CAP_0);
    gpio_set_drive_capability(PIN_DM, GPIO_DRIVE_CAP_0);
    REG_WRITE(GPIO_OUT_W1TC_REG, DP_MASK | DM_MASK);
    REG_WRITE(GPIO_ENABLE_W1TC_REG, DP_MASK | DM_MASK);
}

void bus_float() {
    REG_WRITE(GPIO_ENABLE_W1TC_REG, DP_MASK | DM_MASK);
    REG_WRITE(GPIO_OUT_W1TC_REG, DP_MASK | DM_MASK);
    gpio_set_pull_mode(PIN_DP, GPIO_FLOATING);
    gpio_set_pull_mode(PIN_DM, GPIO_FLOATING);
}

static void bus_release() {
    REG_WRITE(GPIO_ENABLE_W1TC_REG, DP_MASK | DM_MASK);
    REG_WRITE(GPIO_OUT_W1TC_REG, DP_MASK | DM_MASK);
}

void init() {
    cycles_per_us = getCpuFrequencyMhz();
    bus_init();
}

// One key packet, ~323 us, same waveform as Transporter's PIO program:
// both lines low, then per bit: clock low + data for 8 us, clock high for
// 12 us (10 us on the last bit); finally clock low and both released.
static void key_packet() {
    const uint32_t us = cycles_per_us;
    portENTER_CRITICAL(&key_mux);
    REG_WRITE(GPIO_OUT_W1TC_REG, DP_MASK | DM_MASK);
    REG_WRITE(GPIO_ENABLE_W1TS_REG, DP_MASK | DM_MASK);
    uint32_t deadline = cycles() + 4 * us;
    wait_until(deadline);
    for (int bit = 15; bit >= 0; --bit) {
        if ((USB_KEY >> bit) & 1) {
            REG_WRITE(GPIO_OUT_W1TC_REG, DP_MASK);
            REG_WRITE(GPIO_OUT_W1TS_REG, DM_MASK);
        } else {
            REG_WRITE(GPIO_OUT_W1TC_REG, DP_MASK | DM_MASK);
        }
        deadline += 8 * us;
        wait_until(deadline);
        REG_WRITE(GPIO_OUT_W1TS_REG, DP_MASK);  // rising edge: the ROM latches D-
        deadline += (bit ? 12 : 10) * us;
        wait_until(deadline);
    }
    REG_WRITE(GPIO_OUT_W1TC_REG, DP_MASK | DM_MASK);
    REG_WRITE(GPIO_ENABLE_W1TC_REG, DP_MASK | DM_MASK);
    portEXIT_CRITICAL(&key_mux);
}

// Drive D- high for 2 us and read it back. Reads low only if something
// (the ROM's ACK) holds it down hard; an unpowered FM-1 also clamps it.
static bool probe_dm_high() {
    portENTER_CRITICAL(&key_mux);
    REG_WRITE(GPIO_OUT_W1TS_REG, DM_MASK);
    REG_WRITE(GPIO_ENABLE_W1TS_REG, DM_MASK);
    esp_rom_delay_us(2);
    bool v = dm();
    REG_WRITE(GPIO_ENABLE_W1TC_REG, DM_MASK);
    REG_WRITE(GPIO_OUT_W1TC_REG, DM_MASK);
    portEXIT_CRITICAL(&key_mux);
    return v;
}

// 0: nothing, 1: ACK (D- held low), 2: D+ already pulled up (ACK missed).
static int gap_sense(bool *alive) {
    int lows = 0, dp_highs = 0;
    for (int i = 0; i < GAP_PROBES; i++) {
        esp_rom_delay_us(GAP_PROBE_SPACING_US);
        if (dp()) {
            if (++dp_highs >= 2) return 2;
        } else {
            dp_highs = 0;
        }
        if (probe_dm_high()) {
            *alive = true;
            lows = 0;
        } else if (*alive && ++lows >= ACK_PROBE_LOWS) {
            return 1;
        }
    }
    return 0;
}

static bool wait_dp_high(uint32_t timeout_ms) {
    int64_t deadline = esp_timer_get_time() + (int64_t)timeout_ms * 1000;
    int highs = 0;
    while (esp_timer_get_time() < deadline) {
        highs = dp() ? highs + 1 : 0;
        if (highs >= 5) return true;
        esp_rom_delay_us(50);
    }
    return false;
}

KeyResult send_key(KeyStats *s, uint32_t timeout_ms, bool (*poll)(const KeyStats *)) {
    *s = {};
    bus_init();
    delay(5);
    if (dp()) return DP_HIGH_AT_START;
    uint32_t start = millis(), last_poll = start;
    for (;;) {
        uint32_t slot = cycles();
        key_packet();
        s->packets++;
        wait_until(slot + KEY_SLOT_US * cycles_per_us);

        int g = gap_sense(&s->alive);
        if (g == 2) return ANSWER_DP;
        if (g == 1) {
            if (wait_dp_high(DP_HIGH_TIMEOUT_MS)) return ANSWER_ACK;
            s->false_acks++;  // D- low but no D+ pull-up: not an ACK
            s->alive = false;
        }
        uint32_t now = millis();
        if (now - start > timeout_ms) {
            bus_release();
            return TIMEOUT;
        }
        if (now - last_poll >= 100) {
            last_poll = now;
            if (poll(s)) {
                bus_release();
                return CANCELLED;
            }
        }
    }
}

// ---------------------------------------------------------------------------
// Calibration pulses (RMT, hardware-timed)

static rmt_channel_handle_t pulse_ch;
static rmt_encoder_handle_t pulse_enc;
static rmt_symbol_word_t pulse_sym;

static bool pulses_start(bool pullup) {
    rmt_tx_channel_config_t cfg = {};
    cfg.gpio_num = PIN_DP;
    cfg.clk_src = RMT_CLK_SRC_DEFAULT;
    cfg.resolution_hz = PULSE_RES_HZ;
    cfg.mem_block_symbols = 48;
    cfg.trans_queue_depth = 1;
    cfg.flags.io_od_mode = 1;  // "1" = released: the ROM's pull-up holds D+ high
    cfg.flags.init_level = 1;
    if (rmt_new_tx_channel(&cfg, &pulse_ch) != ESP_OK) return false;
    rmt_copy_encoder_config_t enc_cfg = {};
    if (rmt_new_copy_encoder(&enc_cfg, &pulse_enc) != ESP_OK) return false;

    // Keep D+ readable while the RMT drives it.
    gpio_input_enable(PIN_DP);
    gpio_set_pull_mode(PIN_DP, pullup ? GPIO_PULLUP_ONLY : GPIO_PULLDOWN_ONLY);
    gpio_set_drive_capability(PIN_DP, GPIO_DRIVE_CAP_1);

    pulse_sym.level0 = 0;
    pulse_sym.duration0 = PULSE_LOW_TICKS;
    pulse_sym.level1 = 1;
    pulse_sym.duration1 = PULSE_HIGH_TICKS;

    rmt_transmit_config_t tx = {};
    tx.loop_count = -1;
    tx.flags.eot_level = 1;
    if (rmt_enable(pulse_ch) != ESP_OK) return false;
    return rmt_transmit(pulse_ch, pulse_enc, &pulse_sym, sizeof(pulse_sym), &tx) == ESP_OK;
}

static void pulses_stop() {
    if (pulse_ch) {
        rmt_disable(pulse_ch);
        rmt_del_channel(pulse_ch);
        pulse_ch = nullptr;
    }
    if (pulse_enc) {
        rmt_del_encoder(pulse_enc);
        pulse_enc = nullptr;
    }
    bus_init();  // hand D+ back to plain GPIO, released
}

PulseResult calibrate(bool (*cancel)()) {
    PulseResult r = {0, -1, false, false};
    if (!pulses_start(false)) {
        pulses_stop();
        r.rmt_error = true;
        return r;
    }
    int64_t t0 = esp_timer_get_time();
    int lows = 0;
    for (;;) {
        esp_rom_delay_us(PULSE_SAMPLE_US);
        int64_t ms = (esp_timer_get_time() - t0) / 1000;
        if (!dp()) {
            if (++lows == PULSE_LOW_SAMPLES && ms >= CAL_DONE_MIN_MS) {
                r.drop_ms = ms;
                break;
            }
        } else {
            lows = 0;
        }
        if (ms >= PULSE_MAX_MS) break;
        if (cancel()) {
            r.cancelled = true;
            break;
        }
    }
    r.pulse_ms = (esp_timer_get_time() - t0) / 1000;
    pulses_stop();
    return r;
}

// ---------------------------------------------------------------------------
// Self-tests (nothing plugged in)

void pin_check(int *hi, int *lo) {
    bus_init();
    gpio_set_pull_mode(PIN_DP, GPIO_PULLUP_ONLY);
    gpio_set_pull_mode(PIN_DM, GPIO_PULLUP_ONLY);
    esp_rom_delay_us(500);
    *hi = (dp() ? 1 : 0) | (dm() ? 2 : 0);
    gpio_set_pull_mode(PIN_DP, GPIO_PULLDOWN_ONLY);
    gpio_set_pull_mode(PIN_DM, GPIO_PULLDOWN_ONLY);
    esp_rom_delay_us(500);
    *lo = (dp() ? 1 : 0) | (dm() ? 2 : 0);
    bus_init();
}

static volatile uint32_t edge_count;
static volatile int64_t edge_first, edge_last;

static void IRAM_ATTR on_falling_edge(void *) {
    int64_t t = esp_timer_get_time();
    if (edge_count == 0) edge_first = t;
    edge_last = t;
    edge_count = edge_count + 1;
}

bool pulse_test(uint32_t *edges, double *period_us) {
    bus_init();
    *edges = 0;
    *period_us = 0;
    if (!pulses_start(true)) {
        pulses_stop();
        return false;
    }
    edge_count = 0;
    esp_err_t err = gpio_install_isr_service(0);
    if (err != ESP_OK && err != ESP_ERR_INVALID_STATE) {
        pulses_stop();
        return false;
    }
    gpio_set_intr_type(PIN_DP, GPIO_INTR_NEGEDGE);
    gpio_isr_handler_add(PIN_DP, on_falling_edge, nullptr);
    gpio_intr_enable(PIN_DP);
    delay(3000);
    gpio_intr_disable(PIN_DP);
    gpio_isr_handler_remove(PIN_DP);
    gpio_set_intr_type(PIN_DP, GPIO_INTR_DISABLE);
    pulses_stop();
    *edges = edge_count;
    if (*edges >= 2) *period_us = (double)(edge_last - edge_first) / (*edges - 1);
    return true;
}

}  // namespace usbkey
